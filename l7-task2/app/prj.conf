## CMakeLists.txt
```
cmake_minimum_required(VERSION 3.20.0)

list(APPEND BOARD_ROOT ${CMAKE_CURRENT_SOURCE_DIR})
list(APPEND ZEPHYR_EXTRA_MODULES ${CMAKE_CURRENT_SOURCE_DIR}/drivers/our_driver)

find_package(Zephyr REQUIRED)
project(my_zephyr_app)

target_sources(app PRIVATE src/main.cpp)
target_include_directories(app PRIVATE drivers/our_driver)
```

## Kconfig
```
menuconfig APP_HEARTBEAT_PERIOD_MS
    int "Heartbeat LED period in milliseconds"
    default 500
    range 100 2000
    help
      Duration (in ms) for each ON/OFF phase of the heartbeat LED.

source "Kconfig.zephyr"
rsource "drivers/our_driver/Kconfig"
```

## prj.conf
```kconfig
CONFIG_GPIO=y
CONFIG_LOG=y
CONFIG_OUR_DRIVER=y
CONFIG_SHELL=y
CONFIG_SENSOR=y
```

## src/main.cpp
```c
#include <zephyr/kernel.h>
#include <zephyr/logging/log.h>
#include <zephyr/device.h>
#include <zephyr/devicetree.h>
#include "our_driver.h"

LOG_MODULE_REGISTER(main, LOG_LEVEL_INF);

int main(void)
{
    const struct device *driver = DEVICE_DT_GET(DT_NODELABEL(our_driver));

    if (!device_is_ready(driver)) {
        LOG_ERR("our_driver not ready");
        return -ENODEV;
    }

    LOG_INF("our_driver ready — use shell commands:");
    LOG_INF("  sensor set <value>");
    LOG_INF("  sensor fetch");
    LOG_INF("  sensor read");
    LOG_INF("  sensor info");

    while (1) {
        k_msleep(1000);
    }

    return 0;
}
```
