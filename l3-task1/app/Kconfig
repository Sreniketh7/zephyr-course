## l3-task1/app/Kconfig
```kconfig
menuconfig LED_SUBSYSTEM
    bool "LED Subsystem"
    default y

if LED_SUBSYSTEM

choice LED_BLINK_SLEEP_TIME
    prompt "LED blink sleep time"
    default LED_BLINK_SLEEP_SLOW

config LED_BLINK_SLEEP_SLOW
    bool "2s (slow)"

config LED_BLINK_SLEEP_MEDIUM
    bool "1s (medium)"

config LED_BLINK_SLEEP_FAST
    bool "0.5s (fast)"

endchoice

menuconfig ADVANCED_SETTINGS
    bool "Advanced LED settings"

if ADVANCED_SETTINGS

config LED_BRIGHTNESS
    int "LED Brightness (0-100)"
    default 100
    range 0 100

config LED_FADE_DURATION
    int "LED fade duration (ms)"
    default 500

endif  # ADVANCED_SETTINGS

menu "Expert settings"
    depends on ADVANCED_SETTINGS

config LED_DEBUGGING
    bool "Enable LED Debugging"
    default n

config LED_CUSTOM_BLINK_PATTERN
    bool "Custom blink pattern"
    default n

endmenu  # Expert settings

endif  # LED_SUBSYSTEM

source "Kconfig.zephyr"
```

## l4-task1/app/Kconfig
```kconfig
menuconfig APP_HEARTBEAT_PERIOD_MS
    int "Heartbeat LED period in milliseconds"
    default 500
    range 100 2000
    help
      Duration (in ms) for each ON/OFF phase of the heartbeat LED.

source "Kconfig.zephyr"
```

## l6-task2/app/boards/our_board/our_board/Kconfig.our_board
```kconfig
# Copyright (c) 2016 Matthias Boesl
# SPDX-License-Identifier: Apache-2.0

config BOARD_OUR_BOARD
	select SOC_STM32F411XE
```

## l6-task2/app/dts/bindings/our,driver.yaml
```yaml
description : Our Simple On Board LED Driver
compatible  : "our,driver"
include     : base.yaml  #We have the "status" and "compatible" properties in base.yaml, 
                         #so we include it here to avoid repeating those properties in our driver binding file.
properties:
  gpios:
    type: phandle-array
    required: true
```

## l7-task1/app/boards/my_board/board.yml
```yaml
board:
  name : my_board
  full_name: My Board from Scratch
  vendor: iomico
  socs:
    - name: stm32f411xe
```

## l7-task2/app/boards/my_board/my_board_defconfig
```kconfig
# SPDX-License-Identifier: Apache-2.01

CONFIG_SERIAL=y

# console
CONFIG_CONSOLE=y
CONFIG_UART_CONSOLE=y

# enable GPIO
CONFIG_GPIO=y
CONFIG_BOARD_EARLY_INIT_HOOK=y
```
